## conf/bblayers.conf
```bitbake
LCONF_VERSION = "6"

BBPATH = "${TOPDIR}"
BSPDIR := "${@os.path.abspath(os.path.dirname(d.getVar('FILE', True)) + '/../..')}"

BBFILES ?= ""
BBLAYERS = " \
  ${BSPDIR}/sources/poky/meta \
  ${BSPDIR}/sources/poky/meta-poky \
  \
  ${BSPDIR}/sources/meta-openembedded/meta-oe \
  ${BSPDIR}/sources/meta-openembedded/meta-multimedia \
  ${BSPDIR}/sources/meta-openembedded/meta-python \
  ${BSPDIR}/sources/meta-openembedded/meta-gnome \
  ${BSPDIR}/sources/meta-openembedded/meta-networking \
  ${BSPDIR}/sources/meta-openembedded/meta-filesystems \
  \
  ${BSPDIR}/sources/meta-freescale \
  ${BSPDIR}/sources/meta-freescale-3rdparty \
  ${BSPDIR}/sources/meta-freescale-distro \
  \
  ${BSPDIR}/sources/meta-daviscomms/meta-bsp \
  ${BSPDIR}/sources/meta-daviscomms/meta-sdk \
  ${BSPDIR}/sources/meta-daviscomms/meta-ml \
  ${BSPDIR}/sources/meta-nxp-demo-experience \
  \
  ${BSPDIR}/sources/meta-browser/meta-chromium \
  ${BSPDIR}/sources/meta-clang \
  ${BSPDIR}/sources/meta-qt6 \
  ${BSPDIR}/sources/meta-virtualization \
"
```
